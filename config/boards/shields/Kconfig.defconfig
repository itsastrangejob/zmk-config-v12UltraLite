## config/boards/shields/Kconfig.defconfig
```kconfig
# Copyright (c) 2022 The ZMK Contributors
# SPDX-License-Identifier: MIT

if SHIELD_TWO_PERCENT_MILK

config ZMK_KEYBOARD_NAME
    default "v12UltraLite"

endif
```

## config/boards/shields/Kconfig.shield
```kconfig
# Copyright (c) 2022 The ZMK Contributors
# SPDX-License-Identifier: MIT

config SHIELD_v12UltraLite
    def_bool $(shields_list_contains,v12UltraLite)
```
